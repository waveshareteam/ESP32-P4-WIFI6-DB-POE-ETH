## examples/esp-idf/02_sdmmc/main/Kconfig.projbuild
```kconfig
menu "SD/MMC Example Configuration"
    config EXAMPLE_FORMAT_IF_MOUNT_FAILED
        bool "Format the card if mount failed"
        default n
    config EXAMPLE_FORMAT_SD_CARD
        bool "Format the card as a part of the example"
        default n
endmenu
```

## examples/esp-idf/04_i2s_es8311/main/Kconfig.projbuild
```kconfig
menu "Example Configuration"
    choice EXAMPLE_MODE
        prompt "Example mode"
        default EXAMPLE_MODE_MUSIC
        help
            Select example work mode.

        config EXAMPLE_MODE_MUSIC
            bool "music"
        config EXAMPLE_MODE_ECHO
            bool "echo"
    endchoice

    config EXAMPLE_MIC_GAIN
        int "Set MIC gain (unit: dB)"
        depends on EXAMPLE_MODE_ECHO
        default 18

    config EXAMPLE_VOICE_VOLUME
        int "Voice volume"
        range 0 100
        default 60
endmenu
```

## examples/esp-idf/06_eth2ap/sdkconfig.defaults
```kconfig
CONFIG_ESP_HOSTED_CP_TARGET_ESP32C5=y
CONFIG_BOOTLOADER_LOG_LEVEL_WARN=y
CONFIG_BOOTLOADER_COMPILER_OPTIMIZATION_SIZE=y
CONFIG_ETHERNET_PHY_USE_IP101=y
CONFIG_SLAVE_IDF_TARGET_ESP32C5=y
CONFIG_ESP_HOSTED_HOST_SDIO_PIN_CLK=18
CONFIG_ESP_HOSTED_HOST_SDIO_PIN_CMD=19
CONFIG_ESP_HOSTED_HOST_SDIO_PIN_D0=14
CONFIG_ESP_HOSTED_HOST_SDIO_PIN_D1=15
CONFIG_ESP_HOSTED_HOST_SDIO_PIN_D2=16
CONFIG_ESP_HOSTED_HOST_SDIO_PIN_D3=17
CONFIG_ESP_HOSTED_HOST_RESET_GPIO=54
CONFIG_PARTITION_TABLE_SINGLE_APP_LARGE=y
```

## examples/esp-idf/15_bleprph_gatt/main/Kconfig.projbuild
```kconfig
menu "BLE Peripheral GATT config"

config EXAMPLE_NOTIFY_INTERVAL_MS
    int "Notification interval (ms)"
    default 1000
    range 100 60000

endmenu
```
