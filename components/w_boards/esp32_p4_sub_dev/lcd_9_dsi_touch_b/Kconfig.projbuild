## components/waveshare_bmgr/esp32_p4_wifi6_db_poe_eth/sdkconfig.defaults.board
```kconfig
CONFIG_ESPTOOLPY_FLASHMODE_QIO=y
CONFIG_ESPTOOLPY_FLASHFREQ_80M=y
CONFIG_ESPTOOLPY_FLASHSIZE_32MB=y
CONFIG_SPIRAM=y
CONFIG_SPIRAM_MODE_HEX=y
CONFIG_SPIRAM_SPEED_200M=y

CONFIG_CODEC_ES8311_SUPPORT=y
CONFIG_ESP_BOARD_DEV_CAMERA_SUPPORT=y

# Default display: Waveshare 10.1-DSI-TOUCH-A
CONFIG_BSP_LCD_TYPE_800_1280_10_1_INCH_A=y
CONFIG_BSP_LCD_COLOR_FORMAT_RGB565=y
CONFIG_BSP_LCD_DPI_BUFFER_NUMS=3
CONFIG_BSP_LCD_TYPE_AMENDS=n

CONFIG_CAMERA_OV5647=y
CONFIG_CAMERA_OV5647_AUTO_DETECT_MIPI_INTERFACE_SENSOR=y
CONFIG_CAMERA_OV5647_MIPI_RAW8_800X800_50FPS=y
CONFIG_CAMERA_OV5647_MIPI_DEFAULT_FMT_RAW8_800X800_50FPS=y
CONFIG_CAMERA_OV5647_MIPI_IF_FORMAT_INDEX_DEFAULT=2
CONFIG_CAMERA_OV5647_CSI_LINESYNC_ENABLE=y
CONFIG_CAMERA_OV5647_DEFAULT_IPA_JSON_CONFIGURATION_FILE=y

CONFIG_PARTITION_TABLE_CUSTOM=y

# On-board RMII Ethernet (IP101 PHY via espressif/ip101), MDC/MDIO and RMII
# pins declared by the "ethernet" custom device in board_devices.yaml.
CONFIG_ETH_ENABLED=y
CONFIG_ETH_USE_ESP32_EMAC=y
```

## examples/esp-idf/01_i2c_tools/sdkconfig.defaults
```kconfig
CONFIG_BOOTLOADER_LOG_LEVEL_WARN=y
CONFIG_BOOTLOADER_COMPILER_OPTIMIZATION_SIZE=y
```

## examples/esp-idf/02_sdmmc/sdkconfig.defaults
```kconfig
CONFIG_FATFS_VFS_FSTAT_BLKSIZE=4096
CONFIG_BOOTLOADER_LOG_LEVEL_WARN=y
CONFIG_BOOTLOADER_COMPILER_OPTIMIZATION_SIZE=y
```

## examples/esp-idf/04_i2s_es8311/sdkconfig.defaults
```kconfig
CONFIG_CODEC_I2C_BACKWARD_COMPATIBLE=n
CONFIG_BOOTLOADER_LOG_LEVEL_WARN=y
CONFIG_BOOTLOADER_COMPILER_OPTIMIZATION_SIZE=y
```

## examples/esp-idf/06_eth2ap/sdkconfig.defaults
```kconfig
CONFIG_ESP_HOSTED_CP_TARGET_ESP32C5=y
CONFIG_BOOTLOADER_LOG_LEVEL_WARN=y
CONFIG_BOOTLOADER_COMPILER_OPTIMIZATION_SIZE=y
```

## examples/esp-idf/07_ethernet_basic/sdkconfig.defaults
```kconfig
CONFIG_ETH_ENABLED=y
CONFIG_ETH_USE_ESP32_EMAC=y
CONFIG_BOOTLOADER_LOG_LEVEL_WARN=y
CONFIG_BOOTLOADER_COMPILER_OPTIMIZATION_SIZE=y
```

## examples/esp-idf/08_mipi_dsi/main/Kconfig.projbuild
```kconfig
menu "MIPI DSI Example Configuration"

    config ESP_LCD_WHITE_SCREEN_TEST
        bool "Enable LCD white screen test"
        default n
        help
            Show a full white screen instead of the hardware color bar pattern.

    config ESP_LCD_TOUCH_DRAW_TEST
        bool "Enable touchscreen dot drawing test"
        default n
        help
            Poll the BSP GT911 touchscreen and draw magenta dots at touch coordinates.

    config ESP_DEEP_SLEEP_TEST
        bool "Enable deep sleep test"
        depends on !ESP_LCD_TOUCH_DRAW_TEST
        default n
        help
            Enter deep sleep after displaying the selected screen test. This option is unavailable while the
            touchscreen dot drawing test is enabled.

endmenu
```

## examples/esp-idf/09_lvgl/sdkconfig.defaults
```kconfig
CONFIG_SPIRAM=y
CONFIG_LV_USE_SYSMON=y
CONFIG_LV_USE_PERF_MONITOR=y
CONFIG_LV_USE_LOG=y
CONFIG_LV_LOG_LEVEL_WARN=y
CONFIG_LV_LOG_PRINTF=y
CONFIG_LV_BUILD_DEMOS=y
CONFIG_LV_USE_DEMO_BENCHMARK=y
CONFIG_LV_MEM_SIZE_KILOBYTES=128
CONFIG_PARTITION_TABLE_SINGLE_APP_LARGE=y
CONFIG_BOOTLOADER_LOG_LEVEL_WARN=y
CONFIG_BOOTLOADER_COMPILER_OPTIMIZATION_SIZE=y
```

## examples/esp-idf/12_generic_gpio/main/Kconfig.projbuild
```kconfig
menu "GPIO Monitor Example"

    choice GPIO_MONITOR_DEFAULT_MODE
        prompt "Default GPIO mode"
        default GPIO_MONITOR_DEFAULT_MODE_INPUT
        help
            Select the initial GPIO mode for the monitor.

        config GPIO_MONITOR_DEFAULT_MODE_INPUT
            bool "Input"
        config GPIO_MONITOR_DEFAULT_MODE_OUTPUT
            bool "Output"
    endchoice

    choice GPIO_MONITOR_PULL_MODE
        prompt "GPIO pull resistor mode"
        default GPIO_MONITOR_PULL_DOWN
        help
            Select the internal pull resistor configuration for all monitored GPIOs.

        config GPIO_MONITOR_PULL_DOWN
            bool "Pull-down only"
        config GPIO_MONITOR_PULL_UP
            bool "Pull-up only"
        config GPIO_MONITOR_PULL_UP_DOWN
            bool "Both pull-up and pull-down"
        config GPIO_MONITOR_FLOATING
            bool "Floating (no pull)"
    endchoice

endmenu
```

## firmware/brookesia/components/esp_hal_boards/Kconfig
```kconfig
menu "ESP HAL Boards"

config BSP_LCD_BRIGHTNESS_USE_I2C
    bool "Enable Board Manager I2C LCD brightness controller"
    default y
    help
        Enable the custom I2C backlight controller used by the POE-ETH board.
        The board's lcd_brightness device requires this option to expose its
        brightness API.

config ESP_HAL_BOARDS_AUDIO_ENABLE
    bool "Enable Board Manager audio HAL provider"
    depends on !BROOKESIA_HAL_ADAPTOR_ENABLE_AUDIO_DEVICE
    default y
    help
        Register the local audio provider backed by the current ESP Board Manager.
        Keep the official Brookesia audio device disabled to avoid duplicate providers
        and its older Board Manager version constraint.

if ESP_HAL_BOARDS_AUDIO_ENABLE

config ESP_HAL_BOARDS_AUDIO_ENABLE_PROCESSOR
    bool "Enable audio playback, encoder and decoder interfaces"
    default y
    help
        Enable the av_processor based playback, PCM/Opus/G711A and optional AFE layer.

config ESP_HAL_BOARDS_AUDIO_PROCESSOR_AFE_USE_CUSTOM
    bool "Use custom AFE mode instead of ESP-SR AFE"
    depends on ESP_HAL_BOARDS_AUDIO_ENABLE_PROCESSOR
    default n
    help
        Select the custom mode in av_processor. ESP-SR AFE is the supported mode
        for the ESP32-P4 target.

config ESP_HAL_BOARDS_AUDIO_PROCESSOR_DEBUG_LOG
    bool "Enable audio processor debug tracing"
    depends on ESP_HAL_BOARDS_AUDIO_ENABLE_PROCESSOR
    default n

endif # ESP_HAL_BOARDS_AUDIO_ENABLE

endmenu
```

## firmware/brookesia/sdkconfig.defaults
```kconfig
# Board-level settings (flash mode/frequency, PSRAM speed, codec, camera sensor,
# EMAC) come from components/gen_bmgr_codes/board_manager.defaults, which
# esp_board_manager injects with higher priority than this file.
CONFIG_IDF_TARGET="esp32p4"
CONFIG_IDF_EXPERIMENTAL_FEATURES=y
CONFIG_COMPILER_OPTIMIZATION_PERF=y
CONFIG_BOOTLOADER_LOG_LEVEL_ERROR=y

# Flash / partitions
CONFIG_ESPTOOLPY_FLASHMODE_QIO=y
CONFIG_ESPTOOLPY_FLASHSIZE_32MB=y
CONFIG_PARTITION_TABLE_CUSTOM=y

# PSRAM: run code/rodata from PSRAM and keep internal RAM for DMA and the GUI.
CONFIG_SPIRAM=y
CONFIG_SPIRAM_MODE_HEX=y
CONFIG_SPIRAM_FETCH_INSTRUCTIONS=y
CONFIG_SPIRAM_RODATA=y
CONFIG_SPIRAM_XIP_FROM_PSRAM=y
CONFIG_SPIRAM_MALLOC_ALWAYSINTERNAL=0
CONFIG_SPIRAM_MALLOC_RESERVE_INTERNAL=4096
CONFIG_SPIRAM_MEMTEST=n

# Console
CONFIG_ESP_CONSOLE_UART_CUSTOM=y
CONFIG_ESP_CONSOLE_UART_BAUDRATE=2000000

# System
CONFIG_ESP_SYSTEM_EVENT_TASK_STACK_SIZE=4096
CONFIG_ESP_MAIN_TASK_STACK_SIZE=8192
CONFIG_FREERTOS_HZ=1000
CONFIG_VFS_MAX_COUNT=20

# LVGL task/tick are owned by esp_lvgl_adapter; VideoPlayer uses adapter Dummy Draw.
CONFIG_LV_OS_FREERTOS=y
CONFIG_LV_USE_CLIB_MALLOC=y
CONFIG_LV_USE_CLIB_STRING=y
CONFIG_LV_USE_CLIB_SPRINTF=y
CONFIG_LV_DEF_REFR_PERIOD=15
CONFIG_LV_OBJ_STYLE_CACHE=y
CONFIG_LV_DRAW_SW_DRAW_UNIT_CNT=2
CONFIG_LV_USE_LOG=y
CONFIG_LV_LOG_PRINTF=y
CONFIG_LV_USE_SNAPSHOT=y
CONFIG_LV_BUILD_EXAMPLES=n
# VideoPlayer has a project-local esp_lvgl_adapter Dummy Draw backend.
CONFIG_ESP_VIDEO_RENDER_LVGL_BACKEND_SUPPORT=n
# xiaozhi-fonts renders emoji glyphs through LVGL's image-font backend.
CONFIG_LV_USE_IMGFONT=y

# brookesia_core resolves fonts by pixel size at runtime, so keep the full
# Montserrat range it can request.
CONFIG_LV_FONT_MONTSERRAT_8=y
CONFIG_LV_FONT_MONTSERRAT_10=y
CONFIG_LV_FONT_MONTSERRAT_12=y
CONFIG_LV_FONT_MONTSERRAT_16=y
CONFIG_LV_FONT_MONTSERRAT_18=y
CONFIG_LV_FONT_MONTSERRAT_20=y
CONFIG_LV_FONT_MONTSERRAT_22=y
CONFIG_LV_FONT_MONTSERRAT_24=y
CONFIG_LV_FONT_MONTSERRAT_26=y
CONFIG_LV_FONT_MONTSERRAT_28=y
CONFIG_LV_FONT_MONTSERRAT_30=y
CONFIG_LV_FONT_MONTSERRAT_32=y
CONFIG_LV_FONT_MONTSERRAT_34=y
CONFIG_LV_FONT_MONTSERRAT_36=y
CONFIG_LV_FONT_MONTSERRAT_38=y
CONFIG_LV_FONT_MONTSERRAT_40=y
CONFIG_LV_FONT_MONTSERRAT_42=y
CONFIG_LV_FONT_MONTSERRAT_44=y
CONFIG_LV_FONT_FMT_TXT_LARGE=y
CONFIG_LV_USE_FONT_COMPRESSED=y

# ESP-Brookesia core: phone system only
CONFIG_ESP_BROOKESIA_ENABLE_AI_FRAMEWORK=n
CONFIG_ESP_BROOKESIA_GUI_ENABLE_ANIM_PLAYER=n
CONFIG_ESP_BROOKESIA_ENABLE_SERVICES=n
CONFIG_ESP_BROOKESIA_SYSTEMS_ENABLE_SPEAKER=n
CONFIG_BOOST_MATH_ENABLED=n
CONFIG_BOOST_SERIALIZATION_ENABLED=n

# ESP-Hosted: on-board ESP32-C5 over SDIO slot 1 (same pins as firmware/factory_test)
CONFIG_ESP_HOSTED=y
CONFIG_ESP_HOSTED_HOST_FEAT_RPC=y
CONFIG_ESP_HOSTED_HOST_FEAT_RPC_EXT_V2=y
CONFIG_ESP_HOSTED_HOST_FEAT_SYSTEM=y
CONFIG_ESP_HOSTED_HOST_FEAT_WIFI=y
CONFIG_BROOKESIA_HAL_ADAPTOR_ENABLE_WIFI_DEVICE=y
CONFIG_BROOKESIA_HAL_ADAPTOR_ENABLE_STORAGE_DEVICE=y
CONFIG_BROOKESIA_HAL_ADAPTOR_STORAGE_ENABLE_KEY_VALUE_IMPL=y
# This board has no external PMU or battery power manager.
CONFIG_BROOKESIA_HAL_ADAPTOR_ENABLE_POWER_DEVICE=n
CONFIG_ESP_HOSTED_IDF_SLAVE_TARGET="esp32c5"
CONFIG_SLAVE_IDF_TARGET_ESP32C5=y
CONFIG_ESP_HOSTED_CP_TARGET_ESP32C5=y
CONFIG_ESP_HOSTED_P4_DEV_BOARD_NONE=y
CONFIG_ESP_HOSTED_SDIO_SLOT_1=y
CONFIG_ESP_HOSTED_HOST_SDIO_PIN_CLK=18
CONFIG_ESP_HOSTED_HOST_SDIO_PIN_CMD=19
CONFIG_ESP_HOSTED_HOST_SDIO_PIN_D0=14
CONFIG_ESP_HOSTED_HOST_SDIO_PIN_D1=15
CONFIG_ESP_HOSTED_HOST_SDIO_PIN_D2=16
CONFIG_ESP_HOSTED_HOST_SDIO_PIN_D3=17
CONFIG_ESP_HOSTED_HOST_RESET_GPIO=54
CONFIG_ESP_HOSTED_SDIO_RESET_ACTIVE_LOW=y
CONFIG_EH_HOST_PORT_DMA_PREFER_SPIRAM=y
CONFIG_WIFI_RMT_STATIC_RX_BUFFER_NUM=16
CONFIG_WIFI_RMT_DYNAMIC_RX_BUFFER_NUM=64
CONFIG_WIFI_RMT_DYNAMIC_TX_BUFFER_NUM=64
CONFIG_WIFI_RMT_AMPDU_TX_ENABLED=y
CONFIG_WIFI_RMT_TX_BA_WIN=32
CONFIG_WIFI_RMT_AMPDU_RX_ENABLED=y
CONFIG_WIFI_RMT_RX_BA_WIN=32

# lwip
CONFIG_LWIP_TCP_SND_BUF_DEFAULT=65534
CONFIG_LWIP_TCP_WND_DEFAULT=65534
CONFIG_LWIP_TCP_RECVMBOX_SIZE=64
CONFIG_LWIP_UDP_RECVMBOX_SIZE=64
CONFIG_LWIP_TCPIP_RECVMBOX_SIZE=64
CONFIG_LWIP_TCP_SACK_OUT=y


CONFIG_COMPILER_DISABLE_DEFAULT_ERRORS=y
CONFIG_SR_WN_WN9S_NIHAOXIAOZHI=y
CONFIG_FREERTOS_TASK_CREATE_ALLOW_EXT_MEM=y
CONFIG_FREERTOS_SUPPORT_STATIC_ALLOCATION=y
#CONFIG_BROOKESIA_HAL_ADAPTOR_ENABLE_AUDIO_DEVICE=y
CONFIG_ESP_HAL_BOARDS_AUDIO_ENABLE=y
CONFIG_ESP_HAL_BOARDS_AUDIO_ENABLE_PROCESSOR=y
CONFIG_ESP_AUDIO_SIMPLE_PLAYER_RESAMPLE_EN=y
CONFIG_AUDIO_SIMPLE_PLAYER_RESAMPLE_DEST_RATE=48000
CONFIG_ESP_AUDIO_SIMPLE_PLAYER_CH_CVT_EN=y
CONFIG_AUDIO_SIMPLE_PLAYER_CH_CVT_DEST=2
# CONFIG_ESP_HAL_BOARDS_AUDIO_PROCESSOR_AFE_USE_CUSTOM is not set
CONFIG_BSP_LCD_BRIGHTNESS_USE_I2C=y
CONFIG_XIAOZHI_SYNC_SYSTEM_TIME_FROM_SERVER=n
```

## firmware/factory_test/sdkconfig.defaults
```kconfig
CONFIG_IDF_TARGET="esp32p4"
CONFIG_IDF_EXPERIMENTAL_FEATURES=y
CONFIG_ESP_DEFAULT_CPU_FREQ_MHZ_360=y
CONFIG_COMPILER_OPTIMIZATION_PERF=y

# Flash / partitions
CONFIG_ESPTOOLPY_FLASHSIZE_32MB=y
CONFIG_ESPTOOLPY_FLASHMODE_QIO=y
CONFIG_ESPTOOLPY_FLASHFREQ_80M=y
CONFIG_PARTITION_TABLE_CUSTOM=y
CONFIG_PARTITION_TABLE_CUSTOM_FILENAME="partitions.csv"
CONFIG_PARTITION_TABLE_OFFSET=0xA000

# PSRAM (DSI/CSI frame buffers and large test buffers live here)
CONFIG_SPIRAM=y
CONFIG_SPIRAM_MODE_HEX=y
CONFIG_SPIRAM_SPEED_200M=y
CONFIG_SPIRAM_ALLOW_BSS_SEG_EXTERNAL_MEMORY=y
CONFIG_SPIRAM_ALLOW_NOINIT_SEG_EXTERNAL_MEMORY=y

# Console on UART0 (USB download port)
CONFIG_ESP_CONSOLE_UART_DEFAULT=y
CONFIG_ESP_MAIN_TASK_STACK_SIZE=8192
CONFIG_ESP_SYSTEM_EVENT_TASK_STACK_SIZE=4096

# Board Manager
CONFIG_ESP_BOARD_MANAGER_AUTO_CONFIG_DEVICE_AND_PERIPHERAL=y
CONFIG_BSP_LCD_BRIGHTNESS_USE_I2C=y
CONFIG_BSP_LCD_TYPE_720_1280_7_INCH_A=y

# FATFS (SD card + USB MSC)
CONFIG_FATFS_VOLUME_COUNT=2
CONFIG_FATFS_MAX_LFN=255
CONFIG_FATFS_LFN_HEAP=y
CONFIG_FATFS_API_ENCODING_UTF_8=y
CONFIG_FATFS_CODEPAGE_936=y
CONFIG_FATFS_SECTOR_4096=y

# Ethernet (internal EMAC + IP101)
CONFIG_ETH_ENABLED=y
CONFIG_ETH_USE_ESP32_EMAC=y

# ESP-Hosted: ESP32-C5 over SDIO slot 1, initialised on demand by `ifup wifi0`
CONFIG_ESP_HOSTED=y
CONFIG_ESP_HOSTED_HOST_FEAT_RPC=y
CONFIG_ESP_HOSTED_HOST_FEAT_RPC_EXT_V2=y
CONFIG_ESP_HOSTED_HOST_FEAT_SYSTEM=y
CONFIG_ESP_HOSTED_HOST_FEAT_WIFI=y
CONFIG_ESP_HOSTED_AUTO_CALL_INIT_BEFORE_APP_MAIN=n
CONFIG_ESP_HOSTED_IDF_SLAVE_TARGET="esp32c5"
CONFIG_SLAVE_IDF_TARGET_ESP32C5=y
CONFIG_ESP_HOSTED_CP_TARGET_ESP32C5=y
CONFIG_ESP_HOSTED_P4_DEV_BOARD_NONE=y
CONFIG_ESP_HOSTED_SDIO_SLOT_1=y
CONFIG_ESP_HOSTED_HOST_SDIO_PIN_CLK=18
CONFIG_ESP_HOSTED_HOST_SDIO_PIN_CMD=19
CONFIG_ESP_HOSTED_HOST_SDIO_PIN_D0=14
CONFIG_ESP_HOSTED_HOST_SDIO_PIN_D1=15
CONFIG_ESP_HOSTED_HOST_SDIO_PIN_D2=16
CONFIG_ESP_HOSTED_HOST_SDIO_PIN_D3=17
CONFIG_ESP_HOSTED_HOST_RESET_GPIO=54
CONFIG_ESP_HOSTED_SDIO_RESET_ACTIVE_LOW=y
CONFIG_WIFI_RMT_STATIC_RX_BUFFER_NUM=16
CONFIG_WIFI_RMT_DYNAMIC_RX_BUFFER_NUM=32
CONFIG_WIFI_RMT_DYNAMIC_TX_BUFFER_NUM=32
CONFIG_WIFI_RMT_AMPDU_TX_ENABLED=y
CONFIG_WIFI_RMT_TX_BA_WIN=16
CONFIG_WIFI_RMT_AMPDU_RX_ENABLED=y
CONFIG_WIFI_RMT_RX_BA_WIN=16

# lwip / iperf throughput tuning (from examples/esp-idf/15_wifi_iperf)
CONFIG_LWIP_IRAM_OPTIMIZATION=y
CONFIG_LWIP_TCPIP_TASK_PRIO=23
CONFIG_LWIP_TCP_SND_BUF_DEFAULT=41760
CONFIG_LWIP_TCP_WND_DEFAULT=65535
CONFIG_LWIP_TCP_RECVMBOX_SIZE=32
CONFIG_LWIP_UDP_RECVMBOX_SIZE=32
CONFIG_LWIP_TCPIP_RECVMBOX_SIZE=32
CONFIG_LWIP_IP_REASS_MAX_PBUFS=15
CONFIG_LWIP_TCPIP_CORE_LOCKING=y
CONFIG_LWIP_TCPIP_CORE_LOCKING_INPUT=y
CONFIG_LWIP_TCP_SACK_OUT=y
CONFIG_IPERF_TRAFFIC_TASK_PRIORITY=23
CONFIG_IPERF_REPORT_TASK_PRIORITY=24

# Camera (esp_video)
CONFIG_ESP_VIDEO_ENABLE_ISP_PIPELINE_CONTROLLER=y
```
